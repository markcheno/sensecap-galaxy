## firmware/esp32/main/Kconfig.projbuild
```kconfig
menu "Galaxy hardware"
    config GALAXY_LCD_BOUNCE_BUFFER
        bool
        default y
        select SPIRAM_FETCH_INSTRUCTIONS
        select SPIRAM_RODATA
        select LCD_RGB_ISR_IRAM_SAFE
        select LCD_RGB_RESTART_IN_VSYNC
        select UART_ISR_IN_IRAM
        help
            Required for the RGB driver's SRAM bounce buffers. Keep PSRAM
            accessible while NVS writes flash, and recover scan alignment at
            VSYNC after an underrun. Selecting these also upgrades previously
            generated sdkconfig files when this project is rebuilt.
            The storage UART ISR also stays in IRAM to receive data while the
            RGB driver refills bounce buffers or settings are written to flash.
    config GALAXY_LCD_DX
        bool "DX display variant (skip GX/ST7701 serial initialization)"
        default n
    config GALAXY_TOUCH_SWAP_XY
        bool "Swap touch X and Y"
        default n
    config GALAXY_TOUCH_MIRROR_X
        bool "Mirror touch X"
        default y
        help
            Reverse the touch controller's X axis to match the GX display.
            On the tested D1, this makes physical left/right taps correspond
            to the left/right halves of the rendered image.
    config GALAXY_TOUCH_MIRROR_Y
        bool "Mirror touch Y"
        default y
        help
            Reverse the touch controller's Y axis to match the tested GX
            display, including the source-picker header and source rows.
    config GALAXY_LCD_PIXEL_CLOCK
        int "RGB pixel clock in Hz"
        range 8000000 18000000
        default 12000000
endmenu
```

## firmware/esp32/sdkconfig.defaults
```kconfig
CONFIG_IDF_TARGET="esp32s3"
CONFIG_ESPTOOLPY_FLASHSIZE_8MB=y
CONFIG_ESPTOOLPY_FLASHMODE_QIO=y
CONFIG_ESPTOOLPY_FLASHFREQ_80M=y
CONFIG_SPIRAM=y
CONFIG_SPIRAM_MODE_OCT=y
CONFIG_SPIRAM_SPEED_80M=y
CONFIG_SPIRAM_USE_MALLOC=y
CONFIG_SPIRAM_MEMTEST=y
CONFIG_SPIRAM_FETCH_INSTRUCTIONS=y
CONFIG_SPIRAM_RODATA=y
CONFIG_LCD_RGB_ISR_IRAM_SAFE=y
CONFIG_LCD_RGB_RESTART_IN_VSYNC=y
CONFIG_UART_ISR_IN_IRAM=y
CONFIG_GALAXY_TOUCH_MIRROR_X=y
CONFIG_GALAXY_TOUCH_MIRROR_Y=y
CONFIG_ESP_DEFAULT_CPU_FREQ_MHZ_240=y
CONFIG_FREERTOS_HZ=1000
CONFIG_ESP_MAIN_TASK_STACK_SIZE=12288
CONFIG_PARTITION_TABLE_CUSTOM=y
CONFIG_PARTITION_TABLE_CUSTOM_FILENAME="partitions.csv"
CONFIG_ESP32S3_DATA_CACHE_64KB=y
CONFIG_ESP32S3_DATA_CACHE_LINE_64B=y
```
