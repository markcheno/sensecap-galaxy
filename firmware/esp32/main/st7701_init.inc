// Adapted from Seeed-Solution/SenseCAP_Indicator_ESP32, Apache-2.0.
// Modified: standalone 9-bit serial command transport; retained GX register values.
// Upstream commit: 77edb8d2b9a92fc67965c1b2d4a838f0d09a1800
static void st7701_init() {
    lcd_command(0xFF);
    lcd_data(0x77);
    lcd_data(0x01);
    lcd_data(0x00);
    lcd_data(0x00);
    lcd_data(0x10);
    lcd_command(0xC0);
    lcd_data(0x3B);
    lcd_data(0x00);
    lcd_command(0xC1);
    lcd_data(0x0D);
    lcd_data(0x02);
    lcd_command(0xC2);
    lcd_data(0x31);
    lcd_data(0x05);
    lcd_command(0xC7);
    lcd_data(0x04);
    lcd_command(0xCD);
    lcd_data(0x08);
    lcd_command(0xB0);
    lcd_data(0x00);
    lcd_data(0x11);
    lcd_data(0x18);
    lcd_data(0x0E);
    lcd_data(0x11);
    lcd_data(0x06);
    lcd_data(0x07);
    lcd_data(0x08);
    lcd_data(0x07);
    lcd_data(0x22);
    lcd_data(0x04);
    lcd_data(0x12);
    lcd_data(0x0F);
    lcd_data(0xAA);
    lcd_data(0x31);
    lcd_data(0x18);
    lcd_command(0xB1);
    lcd_data(0x00);
    lcd_data(0x11);
    lcd_data(0x19);
    lcd_data(0x0E);
    lcd_data(0x12);
    lcd_data(0x07);
    lcd_data(0x08);
    lcd_data(0x08);
    lcd_data(0x08);
    lcd_data(0x22);
    lcd_data(0x04);
    lcd_data(0x11);
    lcd_data(0x11);
    lcd_data(0xA9);
    lcd_data(0x32);
    lcd_data(0x18);
    lcd_command(0xFF);
    lcd_data(0x77);
    lcd_data(0x01);
    lcd_data(0x00);
    lcd_data(0x00);
    lcd_data(0x11);
    lcd_command(0xB0);
    lcd_data(0x60);
    lcd_command(0xB1);
    lcd_data(0x32);
    lcd_command(0xB2);
    lcd_data(0x07);
    lcd_command(0xB3);
    lcd_data(0x80);
    lcd_command(0xB5);
    lcd_data(0x49);
    lcd_command(0xB7);
    lcd_data(0x85);
    lcd_command(0xB8);
    lcd_data(0x21);
    lcd_command(0xC1);
    lcd_data(0x78);
    lcd_command(0xC2);
    lcd_data(0x78);
    sleep_ms(20);
    lcd_command(0xE0);
    lcd_data(0x00);
    lcd_data(0x1B);
    lcd_data(0x02);
    lcd_command(0xE1);
    lcd_data(0x08);
    lcd_data(0xA0);
    lcd_data(0x00);
    lcd_data(0x00);
    lcd_data(0x07);
    lcd_data(0xA0);
    lcd_data(0x00);
    lcd_data(0x00);
    lcd_data(0x00);
    lcd_data(0x44);
    lcd_data(0x44);
    lcd_command(0xE2);
    lcd_data(0x11);
    lcd_data(0x11);
    lcd_data(0x44);
    lcd_data(0x44);
    lcd_data(0xED);
    lcd_data(0xA0);
    lcd_data(0x00);
    lcd_data(0x00);
    lcd_data(0xEC);
    lcd_data(0xA0);
    lcd_data(0x00);
    lcd_data(0x00);
    lcd_command(0xE3);
    lcd_data(0x00);
    lcd_data(0x00);
    lcd_data(0x11);
    lcd_data(0x11);
    lcd_command(0xE4);
    lcd_data(0x44);
    lcd_data(0x44);
    lcd_command(0xE5);
    lcd_data(0x0A);
    lcd_data(0xE9);
    lcd_data(0xD8);
    lcd_data(0xA0);
    lcd_data(0x0C);
    lcd_data(0xEB);
    lcd_data(0xD8);
    lcd_data(0xA0);
    lcd_data(0x0E);
    lcd_data(0xED);
    lcd_data(0xD8);
    lcd_data(0xA0);
    lcd_data(0x10);
    lcd_data(0xEF);
    lcd_data(0xD8);
    lcd_data(0xA0);
    lcd_command(0xE6);
    lcd_data(0x00);
    lcd_data(0x00);
    lcd_data(0x11);
    lcd_data(0x11);
    lcd_command(0xE7);
    lcd_data(0x44);
    lcd_data(0x44);
    lcd_command(0xE8);
    lcd_data(0x09);
    lcd_data(0xE8);
    lcd_data(0xD8);
    lcd_data(0xA0);
    lcd_data(0x0B);
    lcd_data(0xEA);
    lcd_data(0xD8);
    lcd_data(0xA0);
    lcd_data(0x0D);
    lcd_data(0xEC);
    lcd_data(0xD8);
    lcd_data(0xA0);
    lcd_data(0x0F);
    lcd_data(0xEE);
    lcd_data(0xD8);
    lcd_data(0xA0);
    lcd_command(0xEB);
    lcd_data(0x02);
    lcd_data(0x00);
    lcd_data(0xE4);
    lcd_data(0xE4);
    lcd_data(0x88);
    lcd_data(0x00);
    lcd_data(0x40);
    lcd_command(0xEC);
    lcd_data(0x3C);
    lcd_data(0x00);
    lcd_command(0xED);
    lcd_data(0xAB);
    lcd_data(0x89);
    lcd_data(0x76);
    lcd_data(0x54);
    lcd_data(0x02);
    lcd_data(0xFF);
    lcd_data(0xFF);
    lcd_data(0xFF);
    lcd_data(0xFF);
    lcd_data(0xFF);
    lcd_data(0xFF);
    lcd_data(0x20);
    lcd_data(0x45);
    lcd_data(0x67);
    lcd_data(0x98);
    lcd_data(0xBA);
    lcd_command(0x36);
    lcd_data(0x10);
    lcd_command(0xFF);
    lcd_data(0x77);
    lcd_data(0x01);
    lcd_data(0x00);
    lcd_data(0x00);
    lcd_data(0x13);
    lcd_command(0xE5);
    lcd_data(0xE4);
    lcd_command(0xFF);
    lcd_data(0x77);
    lcd_data(0x01);
    lcd_data(0x00);
    lcd_data(0x00);
    lcd_data(0x00);
    lcd_command(0x3A);
    lcd_data(0x60);
    lcd_command(0x21);
    lcd_command(0x11);
    sleep_ms(120);
    lcd_command(0x29);
    sleep_ms(120);
}
